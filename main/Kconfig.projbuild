## main/Kconfig.projbuild
```kconfig
menu "Board Hardware & Display Configuration"

    choice BOARD_MODEL
        prompt "Target Board / Display Type"
        default BOARD_MODEL_WAVESHARE_TOUCH_LCD_2
        help
            Select the hardware board configuration and display type.

        config BOARD_MODEL_WAVESHARE_TOUCH_LCD_2
            bool "Waveshare ESP32-S3-Touch-LCD-2 (2.0inch ST7789 SPI LCD)"

        config BOARD_MODEL_SSD1306_I2C
            bool "Generic ESP32-S3 with SSD1306 I2C OLED (128x64)"

        config BOARD_MODEL_HEADLESS
            bool "Headless (No Display, Serial output only)"
    endchoice

    menu "Waveshare ST7789 LCD Pins"
        depends on BOARD_MODEL_WAVESHARE_TOUCH_LCD_2

        config LCD_SPI_MOSI
            int "SPI MOSI GPIO Num"
            default 38

        config LCD_SPI_CLK
            int "SPI CLK GPIO Num"
            default 39

        config LCD_SPI_CS
            int "LCD CS GPIO Num"
            default 45

        config LCD_DC
            int "LCD DC GPIO Num"
            default 42

        config LCD_RST
            int "LCD RST GPIO Num (-1 if none)"
            default 0

        config LCD_BL
            int "LCD Backlight GPIO Num (-1 if none)"
            default 1

        config LCD_WIDTH
            int "LCD Width in pixels"
            default 240

        config LCD_HEIGHT
            int "LCD Height in pixels"
            default 320
    endmenu

    menu "SSD1306 I2C Configuration"
        depends on BOARD_MODEL_SSD1306_I2C

        config I2C_MASTER_SCL
            int "SCL GPIO Num"
            default 9

        config I2C_MASTER_SDA
            int "SDA GPIO Num"
            default 8

        config I2C_MASTER_FREQUENCY
            int "Master Frequency (Hz)"
            default 400000
    endmenu

endmenu
```
